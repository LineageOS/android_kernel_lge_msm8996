/* Copyright (c) 2012, Code Aurora Forum. All rights reserved.
 *
 * This program is free software; you can redistribute it and/or modify
 * it under the terms of the GNU General Public License version 2 and
 * only version 2 as published by the Free Software Foundation.
 *
 * This program is distributed in the hope that it will be useful,
 * but WITHOUT ANY WARRANTY; without even the implied warranty of
 * MERCHANTABILITY or FITNESS FOR A PARTICULAR PURPOSE.  See the
 * GNU General Public License for more details.
 */


&i2c_8 {
	qcom,disable-dma;
	pn54x@28 {
		compatible = "nxp,pn548";
		reg = <0x28>;
		status = "okay";
		nxp,pn5xx-ven = <&tlmm 12 0x00>;
		nxp,pn5xx-fw-dwnld = <&tlmm 11 0x00>;
		nxp,pn5xx-irq = <&tlmm 9 0x00>;
		nxp,pn5xx-ese-pwr = <&pm8994_gpios 7 0x00>;
		nxp,pn5xx-clkreq = <&pm8994_gpios 10 0x00>;
		interrupt-parent = <&tlmm>;
		qcom,clk-src = "BBCLK2";
		interrupts = <9 0x4>;
		interrupt-names = "nfc_irq";
		clocks = <&clock_gcc clk_bb_clk2_pin>;
		clock-names = "ref_clk";
	};
};
