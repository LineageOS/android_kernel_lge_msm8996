/* Copyright (c) 2016, Code Aurora Forum. All rights reserved.
 *
 * This program is free software; you can redistribute it and/or modify
 * it under the terms of the GNU General Public License version 2 and
 * only version 2 as published by the Free Software Foundation.
 *
 * This program is distributed in the hope that it will be useful,
 * but WITHOUT ANY WARRANTY; without even the implied warranty of
 * MERCHANTABILITY or FITNESS FOR A PARTICULAR PURPOSE.  See the
 * GNU General Public License for more details.
 */

&soc {
	lge-mme {
		compatible = "lge-mme";
		lge-mme,gpio_sleep_n = <&tlmm 3 0>;
		lge-mme,gpio_ph = <&tlmm 0 0>;
		lge-mme,gpio_en = <&tlmm 2 0>;

		pinctrl-0 = <&lge_mme_active>;
		pinctrl-1 = <&lge_mme_sleep>;

		status = "disabled";
	};

	lge-mme-drv {
		compatible = "lge-mme-drv";
	};
};

&spi_0 {
		status = "disabled";
};
