## arch/arm64/configs/lge_msm8996_defconfig
```kconfig
include msm-perf_defconfig

# LG Platform
CONFIG_MACH_LGE=y

# ARM
CONFIG_NR_CPUS=4
CONFIG_CPUSETS=y
CONFIG_PROC_PID_CPUSET=y

# Useful for Android
CONFIG_IPV6_VTI=y
CONFIG_CRYPTO_GCM=y
CONFIG_CRYPTO_SHA512=y
CONFIG_TASK_DELAY_ACCT=y
CONFIG_BLK_DEV_IO_TRACE=y

# BPF
CONFIG_BPF_JIT=y
CONFIG_BPF_JIT_ALWAYS_ON=y
CONFIG_BPF_SYSCALL=y
CONFIG_CGROUP_BPF=y
CONFIG_KPROBES=y
CONFIG_NET_ACT_BPF=y
CONFIG_NET_CLS_BPF=y
CONFIG_SOCK_CGROUP_DATA=y
CONFIG_NETFILTER_XT_MATCH_BPF=y
CONFIG_NETFILTER_XT_MATCH_OWNER=y

# Bluetooth
CONFIG_BT_BCM43XX=y
CONFIG_BT_MSM_SLEEP=y

# Fingerprint Cards
CONFIG_INPUT_FINGERPRINT=y
CONFIG_INPUT_FINGERPRINT_FPC1020=y

# NXP
CONFIG_NFC=y
CONFIG_NFC_PN548=y

# For GPS - need rom support (DR_SYNC_ENABLED)
CONFIG_PPS=n
CONFIG_PPS_CLIENT_GPIO=n

# LGE - Camera
CONFIG_LG_OIS=y
CONFIG_LGE_CAM_PREVIEW_TUNE=n

# LGE - Sound
CONFIG_SND_LGE_MABL=n
CONFIG_SND_LGE_EFFECT=n
CONFIG_SND_LGE_NORMALIZER=n

# LGE - Display
CONFIG_LGE_VSYNC_SKIP=y
CONFIG_LGE_PANEL_RECOVERY=y
CONFIG_LGE_DISPLAY_COMMON=y
CONFIG_LGE_LCD_OFF_DIMMING=y
CONFIG_LGE_PP_AD_SUPPORTED=y
CONFIG_LGE_HIGH_LUMINANCE_MODE=y
CONFIG_LGE_SP_MIRRORING_CTRL_BL=y
CONFIG_LGE_DISPLAY_AOD_SUPPORTED=y
CONFIG_LGE_DISPLAY_LABIBB_RECOVERY=y
CONFIG_LGE_LCD_DYNAMIC_CABC_MIE_CTRL=y
CONFIG_LGE_DISPLAY_OVERRIDE_MDSS_DSI_PANEL_POWER_ON=y
CONFIG_LGE_DISPLAY_OVERRIDE_MDSS_DSI_PANEL_POWER_OFF=y
CONFIG_LGE_DISPLAY_OVERRIDE_MDSS_DSI_PANEL_ON=y
CONFIG_LGE_DISPLAY_OVERRIDE_MDSS_DSI_PANEL_OFF=y
CONFIG_LGE_DISPLAY_OVERRIDE_MDSS_DSI_PANEL_RESET=y
CONFIG_LGE_DISPLAY_OVERRIDE_MDSS_DSI_CTRL_SHUTDOWN=y

# PM
CONFIG_LGE_PM=y
CONFIG_QPNP_FG_EXTENSION=y
CONFIG_QPNP_SMBCHARGER_EXTENSION=y
CONFIG_LGE_FIX_BATT_TEMP_READING=y

# USB
CONFIG_USB_PD=y
CONFIG_USB_PD_POLICY=y
CONFIG_DUAL_ROLE_USB_INTF=y
CONFIG_LGE_USB_TYPE_C=y

# Other
CONFIG_RD_XZ=y
CONFIG_XZ_DEC=y
# CONFIG_XZ_DEC_X86 is not set
# CONFIG_XZ_DEC_POWERPC is not set
# CONFIG_XZ_DEC_IA64 is not set
CONFIG_XZ_DEC_ARM=y
# CONFIG_XZ_DEC_ARMTHUMB is not set
# CONFIG_XZ_DEC_SPARC is not set
CONFIG_XZ_DEC_BCJ=y
# CONFIG_XZ_DEC_TEST is not set
CONFIG_DECOMPRESS_XZ=y
CONFIG_SLIMBUS=y
CONFIG_MFD_H1_DSV=y
CONFIG_WQ_POWER_EFFICIENT_DEFAULT=y
CONFIG_CPU_FREQ_TIMES=n

# EXT Filesystems
CONFIG_EXT2_FS=n
CONFIG_EXT3_FS=n
CONFIG_EXT4_ENCRYPTION=y
CONFIG_EXT4_FS_ENCRYPTION=y
CONFIG_EXT4_USE_FOR_EXT23=y

# DOS/FAT/NT Filesystems
CONFIG_MSDOS_FS=n
CONFIG_VFAT_FS=n
CONFIG_SDFAT_FS=y
CONFIG_SDFAT_USE_FOR_EXFAT=y
CONFIG_SDFAT_USE_FOR_VFAT=y
CONFIG_SDFAT_DELAYED_META_DIRTY=y
CONFIG_SDFAT_SUPPORT_DIR_SYNC=y
CONFIG_SDFAT_DEFAULT_CODEPAGE=437
CONFIG_SDFAT_DEFAULT_IOCHARSET="utf8"
CONFIG_SDFAT_CHECK_RO_ATTR=y
CONFIG_SDFAT_ALIGNED_MPAGE_WRITE=y
CONFIG_SDFAT_VIRTUAL_XATTR=y
CONFIG_SDFAT_VIRTUAL_XATTR_SELINUX_LABEL="u:object_r:sdcard_external:s0"
CONFIG_SDFAT_DEBUG=n
CONFIG_SDFAT_SUPPORT_STLOG=y
CONFIG_SDFAT_STATISTICS=y

# Treble
CONFIG_CP15_BARRIER_EMULATION=y
CONFIG_SETEND_EMULATION=y
CONFIG_SECURITY_PERF_EVENTS_RESTRICT=y

# VDSO
CONFIG_COMPAT_VDSO=y

# Vibrator
CONFIG_QPNP_HAPTIC=y

# Disable QCOM drivers to avoid confliction
CONFIG_BT_RFCOMM=n
CONFIG_MSM_BT_POWER=n
CONFIG_NFC_NQ=n
CONFIG_CNSS=n
CONFIG_USELIB=n
CONFIG_SMB135X_CHARGER=n

# Disable configs that can cause the kernel build to fail
CONFIG_ACPI=n
CONFIG_CPU_BOOST=n

# Disable legacy camera (We're using MSMB_CAMERA in 4.4)
CONFIG_MSM_CAMERA=n
CONFIG_MSM_CAMERA_DEBUG=n
CONFIG_MSMB_CAMERA_DEBUG=n

# Work around some camera issues specific to LGE on 4.4
CONFIG_LGE_ISP_CMD_WORKAROUND_FOR_44=y

# OTG Wakelock is enabled on sony's tone platform, and our USB stack is based on theirs
CONFIG_USB_OTG_WAKELOCK=y

# UID Stats
CONFIG_UID_SYS_STATS=y

# Enable Flatmem (slightly lower RAM usage at runtime)
CONFIG_ARCH_FLATMEM_ENABLE=y
CONFIG_FLATMEM_MANUAL=y
CONFIG_FLATMEM=y
CONFIG_FLAT_NODE_MEM_MAP=y

# Ramoops support (useful for Debugging kernel panics)
CONFIG_QCOM_PRESERVE_MEM=y
CONFIG_PSTORE=y
CONFIG_PSTORE_CONSOLE=y
CONFIG_PSTORE_PMSG=y
CONFIG_PSTORE_RAM=y

# Disable duplicate "qcrypto" driver registration, fixing qualcomm's crypto engine init
CONFIG_CRYPTO_DEV_QCE=n


########################### LGE_8996 kernel 4.4 tweaks

###### Disable general kernel drivers not used by LGE_msm8996
CONFIG_EFI=n
CONFIG_JBD=n
CONFIG_LOGO=n
CONFIG_ESOC=n
CONFIG_UID16=n
CONFIG_ATL1C=n
CONFIG_IMX134=n
CONFIG_IMX132=n
CONFIG_OV9724=n
CONFIG_OV5648=n
CONFIG_GC0339=n
CONFIG_OV8825=n
CONFIG_OV8865=n
CONFIG_s5k4e1=n
CONFIG_BT_BNEP=n
CONFIG_BT_HIDP=n
CONFIG_OV12830=n
CONFIG_BONDING=n
CONFIG_MODULES=n
CONFIG_WIL6210=n
CONFIG_VGA_ARB=n
CONFIG_MSM_MHI=n
CONFIG_MSM_11AD=n
CONFIG_MMC_TEST=n
CONFIG_RD_BZIP2=n
CONFIG_MSM_RDBG=n
CONFIG_ATH_CARDS=n
CONFIG_TRACER_PKT=n
CONFIG_SPI_SPIDEV=n
CONFIG_TI_DRV2667=n
CONFIG_SEEMP_CORE=n
CONFIG_PCI_QUIRKS=n
CONFIG_SCHEDSTATS=n
CONFIG_EEPROM_AT24=n
CONFIG_CHR_DEV_SCH=n
CONFIG_MEDIA_TUNER=n
CONFIG_CNSS_CRYPTO=n
CONFIG_USB_ISP1760=n
CONFIG_SECURE_TOUCH=n
CONFIG_IOSCHED_TEST=n
CONFIG_INPUT_MOUSEDEV=n
CONFIG_LIMITS_LITE_HW=n
CONFIG_SMB135X_CHARGER=n
CONFIG_LCD_CLASS_DEVICE=n
CONFIG_INPUT_HBTP_INPUT=n

# Disable general profiling, logging and debugging
CONFIG_PROFILING=n
CONFIG_CORESIGHT=n
CONFIG_DEBUG_INFO=n
CONFIG_INPUT_EVBUG=n
CONFIG_IOMMU_DEBUG=n
CONFIG_CMA_DEBUGFS=n
CONFIG_IPC_LOGGING=n
CONFIG_SCSI_LOGGING=n
CONFIG_MSM_SMEM_LOGGING=n
CONFIG_MMC_PERF_PROFILING=n
CONFIG_RMNET_DATA_DEBUG_PKT=n
CONFIG_FB_MSM_MDSS_XLOG_DEBUG=n

# Disable ALIGN_RODATA to reduce RAM usage with no noticeable performance decrease
CONFIG_DEBUG_ALIGN_RODATA=n

# Android does not use ECRYPT_FS at all, neither for FBE or FDE
CONFIG_ECRYPT_FS=n

# IDLE_GOV_MENU is not needed since we already have qualcomm's cpu idle implementation
CONFIG_CPU_IDLE_GOV_MENU=n

# Android does not use RT_GROUP_SCHED.
CONFIG_RT_GROUP_SCHED=n

# Disable support for obsolete libc system calls
CONFIG_SYSFS_SYSCALL=n

# This is not used by our devices
CONFIG_BACKLIGHT_GENERIC=n

# These errata are meant for ARM's Cortex-A5x cpus, let's not apply them on kryo
CONFIG_ARM64_ERRATUM_826319=n
CONFIG_ARM64_ERRATUM_827319=n
CONFIG_ARM64_ERRATUM_824069=n
CONFIG_ARM64_ERRATUM_819472=n
CONFIG_ARM64_ERRATUM_832075=n
CONFIG_ARM64_ERRATUM_845719=n
CONFIG_ARM64_ERRATUM_843419=n
CONFIG_ARM64_ERRATUM_1024718=n

# These, on the other hand, are meant for Cavium's ThunderX chips
CONFIG_CAVIUM_ERRATUM_22375=n
CONFIG_CAVIUM_ERRATUM_23154=n
CONFIG_CAVIUM_ERRATUM_27456=n

# Do not set a minimum amout of loop devices to be created
CONFIG_BLK_DEV_LOOP_MIN_COUNT=0

# We have no use for this fixture device
CONFIG_USB_EHSET_TEST_FIXTURE=n

# No need for AES through NEON when we already have ArmV8's
# Crypto Extensions.
CONFIG_CRYPTO_AES_ARM64_NEON_BLK=n

# This should be disabled on production devices.
CONFIG_REGMAP_ALLOW_WRITE_DEBUGFS=n

# None of these touchscreen drivers are used by LGE_msm8996
CONFIG_TOUCHSCREEN_GEN_VKEYS=n
CONFIG_TOUCHSCREEN_ATMEL_MXT=n
CONFIG_TOUCHSCREEN_ATMEL_MAXTOUCH_TS=n
CONFIG_TOUCHSCREEN_SYNAPTICS_DSX_v21=n
CONFIG_TOUCHSCREEN_SYNAPTICS_DSX_v26=n

# Disable verity to match Lineage's charter about verity on system images
CONFIG_DM_VERITY=n


# Enable perf events
CONFIG_PERF_EVENTS=y

# Enable AUDIT configs to harden security
CONFIG_AUDIT=y
CONFIG_AUDITSYSCALL=y
CONFIG_AUDIT_WATCH=y
CONFIG_AUDIT_TREE=y

# Jump label can improve performance in certain cases
CONFIG_JUMP_LABEL=y

# Adjust the log buffer to be closer to wahoo
CONFIG_LOG_BUF_SHIFT=20

# Skip sys_sync on suspend, the cost isn't worth it
CONFIG_SUSPEND_SKIP_SYNC=y

# Enable a system-wide ring of trusted keys
CONFIG_SYSTEM_TRUSTED_KEYRING=y

# Use qcom's CPUIDLE implementation
CONFIG_CPU_IDLE=y

# Enable drivers that are useful for LGE_msm8996
CONFIG_THERMAL=y
CONFIG_THERMAL_EMULATION=n
CONFIG_THERMAL_QPNP=y
CONFIG_QCOM_THERMAL_LIMITS_DCVS=y
CONFIG_MSM_APP_API=y
CONFIG_ENABLE_FP_SIMD_SETTINGS=y
CONFIG_MSM_APP_SETTINGS=y
CONFIG_SENSORS_QPNP_ADC_CURRENT=y
CONFIG_VIDEOBUF2_VMALLOC=y
CONFIG_MSM_V4L2_VIDEO_OVERLAY_DEVICE=y
CONFIG_USB_HIDDEV=y
CONFIG_USB_MON=y
CONFIG_NOP_USB_XCEIV=y
CONFIG_QCOM_EARLY_RANDOM=y
CONFIG_SERIAL_MSM=y
CONFIG_COMPAT_BRK=y
CONFIG_REGULATOR_STUB=y

# Enable configs for zram support and faster de/compression
CONFIG_ZRAM=y
CONFIG_ZSMALLOC=y
CONFIG_CRYPTO_LZ4=y
```

## drivers/input/touchscreen/lge/lgsic/Kconfig
```kconfig
#
# LGE touch core configuration
#
if INPUT_TOUCHSCREEN

menuconfig LGE_TOUCH_LGSIC_LG4945
	bool "LGE Touch Core ODM Device Driver - LG4945"
	depends on LGE_TOUCH_CORE_BASE
	help
	  If your device is lg4945, say Y

menuconfig LGE_TOUCH_LGSIC_LG4946
	bool "LGE Touch Core ODM Device Driver - LG4946"
	depends on LGE_TOUCH_CORE_BASE
	help
	  If your device is lg4946, say Y

# To Do : LGSIC Chipseet
endif
```

## drivers/nfc/Kconfig
```kconfig
#
# Near Field Communication (NFC) devices
#

menu "Near Field Communication (NFC) devices"
	depends on NFC

endmenu

config NFC_BCM2079X
	bool "Broadcom 2079X NFC Controller Driver"
	depends on I2C
	select CRC_CCITT
	help
	  Broadcom 2079X Near Field Communication controller support.

config NFC_NQ
	tristate "Qualcomm NCI based NFC Controller Driver for NQx"
	depends on I2C
	help
	  This enables the NFC driver for NQx based devices.
	  This is for i2c connected version. NCI protocol logic
	  resides in the usermode and it has no other NFC dependencies.

config NFC_PN548
	tristate "PN548 NFC driver"
	help
	  NXP PN548 driver.
	  This driver provides support for NFC NXP PN548 devices.

	  Say Y here to compile support for PN548 devices into the
	  kernel or say M to compile it as module (pn548).

config CXD224X_NFC
    tristate "CXD224X NFC driver"
    depends on I2C
    select CRC_CCITT
    default n
    ---help---
      Say yes if you want cxd224x Near Field Communication driver.
      This is for i2c connected version. If unsure, say N here.

      To compile this driver as a module, choose m here. The module will
      be called cxd224x-i2c.

config CXD224X_NFC_VEN
    tristate "CXD224X NFC VEN"
    depends on CXD224X_NFC
    default n
    ---help---
      Say yes if you want to use cxd224x NFC VEN(enable voltage) control.
      If unsure, say N here.

config CXD224X_NFC_RST
    tristate "CXD224X NFC RST"
    depends on CXD224X_NFC
    default y
    ---help---
      Say yes if you want to use cxd224x NFC RST(external XRST pin) control.
```
